## lib/libzorpll/Config.in
```kconfig
config	libzorpll
	prompt "libzorpll.......................... Low level functions for Zorp"
	tristate
```

## net/kzorp/Config.in
```kconfig
config kzorp
	prompt "kzorp.......................... Zorp related kernel modules"
	tristate
```

## net/zorp-iptables-addons/Config.in
```kconfig
config ZORP_IPTABLES_ADDONS
	prompt "Zorp IPTables addons.......................... Zorp userspace IPTables addons"
	tristate
```

## net/zorp/Config.in
```kconfig
config zorp
	prompt "zorp.......................... Zorp application layer firewall"
	tristate
```
